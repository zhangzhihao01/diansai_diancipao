/*******************************************************************************
【Crystal 】 50.000Mhz
【busclock】100.000MHz
【pllclock】200.000MHz
******************************************************************************/
#include "include.h"

u8 Image_Data1[IMAGEH][IMAGEW];      //图像原始数据存放
u8 Image_Data2[IMAGEH][IMAGEW];      //（双缓冲用
//u8 Pic1[120][184]; 
u8 Pic2[120][184];
u8 Pic3[LCDH][LCDW];
u8 Image_Use[LCDH][LCDW];            //压缩后之后用于存放屏幕显示数据
u8 Pixle[LCDH][LCDW];               //二值化后用于OLED显示的数据
u8  Line_Cont=0;          //行计数
u8  Field_Over_Flag=0;    //场标识
u8  No=1;                 //判断奇偶场（双缓冲用

u8 ans[120][184][2] =
{
{{15,40},{15,41},{15,41},{15,42},{15,43},{15,43},{14,44},{14,45},{14,45},{14,45},{14,46},{14,46},{14,47},{14,48},{14,48},{14,49},{14,50},{14,50},{14,50},{14,51},{14,51},{14,52},{14,53},{14,53},{14,54},{14,55},{14,55},{13,56},{13,57},{13,57},{13,57},{13,58},{13,58},{13,59},{13,60},{13,60},{13,61},{13,62},{13,62},{13,63},{13,64},{13,64},{13,65},{13,66},{13,66},{13,67},{13,67},{13,67},{13,68},{13,69},{13,69},{13,70},{13,71},{13,71},{13,72},{13,73},{13,73},{13,74},{13,75},{13,75},{12,76},{12,77},{12,77},{12,78},{12,79},{12,79},{12,80},{12,81},{12,81},{12,82},{12,82},{12,82},{12,83},{12,84},{12,84},{12,85},{12,86},{12,86},{12,87},{12,88},{12,89},{12,89},{12,90},{12,91},{12,91},{12,92},{12,93},{12,93},{12,94},{12,95},{12,95},{12,96},{12,97},{12,97},{12,98},{12,99},{12,99},{12,100},{12,101},{12,101},{12,102},{12,102},{12,103},{12,103},{12,104},{12,105},{12,105},{12,106},{12,107},{12,107},{12,108},{13,109},{13,109},{13,110},{13,111},{13,111},{13,112},{13,113},{13,114},{13,114},{13,115},{13,116},{13,116},{13,117},{13,117},{13,117},{13,118},{13,119},{13,119},{13,120},{13,121},{13,122},{13,122},{13,123},{13,124},{13,124},{13,125},{13,126},{13,126},{13,127},{13,127},{13,127},{13,128},{14,129},{14,130},{14,130},{14,131},{14,132},{14,132},{14,133},{14,134},{14,134},{14,134},{14,135},{14,136},{14,136},{14,137},{14,138},{14,138},{14,139},{14,139},{14,139},{14,140},{15,141},{15,142},{15,142},{15,143},{15,144},{15,144},{15,144},{15,145},{15,146},{15,146},{15,147},{15,147},{15,147},{15,148},{15,149},{15,149},{16,150},{16,150},{16,151},{16,151},{16,152}},
{{15,40},{15,40},{15,41},{15,42},{15,42},{15,43},{14,44},{14,44},{14,45},{14,45},{14,45},{14,46},{14,47},{14,47},{14,48},{14,49},{14,49},{14,50},{14,50},{14,50},{14,51},{14,52},{14,52},{14,53},{14,54},{14,54},{14,55},{13,56},{13,56},{13,57},{13,57},{13,57},{13,58},{13,59},{13,59},{13,60},{13,61},{13,61},{13,62},{13,63},{13,63},{13,64},{13,65},{13,65},{13,66},{13,67},{13,67},{13,67},{13,68},{13,68},{13,69},{13,70},{13,70},{13,71},{13,72},{13,72},{13,73},{13,74},{13,74},{13,75},{12,76},{12,76},{12,77},{12,78},{12,79},{12,79},{12,80},{12,81},{12,81},{12,82},{12,82},{12,82},{12,83},{12,84},{12,84},{12,85},{12,86},{12,86},{12,87},{12,88},{12,88},{12,89},{12,90},{12,90},{12,91},{12,92},{12,93},{12,93},{12,94},{12,95},{12,95},{12,96},{12,97},{12,97},{12,98},{12,99},{12,99},{12,100},{12,101},{12,101},{12,102},{12,102},{12,103},{12,103},{12,104},{12,105},{12,105},{12,106},{12,107},{12,107},{12,108},{13,109},{13,109},{13,110},{13,111},{13,112},{13,112},{13,113},{13,114},{13,114},{13,115},{13,116},{13,116},{13,117},{13,117},{13,118},{13,118},{13,119},{13,120},{13,120},{13,121},{13,122},{13,122},{13,123},{13,124},{13,125},{13,125},{13,126},{13,127},{13,127},{13,127},{13,128},{13,128},{14,129},{14,130},{14,131},{14,131},{14,132},{14,133},{14,133},{14,134},{14,134},{14,134},{14,135},{14,136},{14,137},{14,137},{14,138},{14,139},{14,139},{14,139},{14,140},{15,141},{15,141},{15,142},{15,143},{15,143},{15,144},{15,144},{15,144},{15,145},{15,146},{15,147},{15,147},{15,147},{15,148},{15,148},{15,149},{16,150},{16,150},{16,150},{16,151},{16,152},{16,152}},
{{15,40},{15,40},{15,40},{15,41},{15,42},{15,42},{15,43},{14,44},{14,44},{14,45},{14,45},{14,45},{14,46},{14,47},{14,47},{14,48},{14,49},{14,49},{14,50},{14,50},{14,51},{14,51},{14,52},{14,53},{14,53},{14,54},{14,55},{14,55},{13,56},{13,57},{13,57},{13,57},{13,58},{13,58},{13,59},{13,60},{13,60},{13,61},{13,62},{13,62},{13,63},{13,64},{13,64},{13,65},{13,66},{13,66},{13,67},{13,67},{13,67},{13,68},{13,69},{13,69},{13,70},{13,71},{13,72},{13,72},{13,73},{13,74},{13,74},{13,75},{12,76},{12,76},{12,77},{12,78},{12,78},{12,79},{12,80},{12,80},{12,81},{12,82},{12,82},{12,82},{12,83},{12,84},{12,84},{12,85},{12,86},{12,86},{12,87},{12,88},{12,88},{12,89},{12,90},{12,90},{12,91},{12,92},{12,93},{12,93},{12,94},{12,95},{12,95},{12,96},{12,97},{12,97},{12,98},{12,99},{12,99},{12,100},{12,101},{12,102},{12,102},{12,102},{12,103},{12,103},{12,104},{12,105},{12,105},{12,106},{12,107},{12,107},{12,108},{13,109},{13,110},{13,110},{13,111},{13,112},{13,112},{13,113},{13,114},{13,114},{13,115},{13,116},{13,117},{13,117},{13,117},{13,118},{13,118},{13,119},{13,120},{13,120},{13,121},{13,122},{13,123},{13,123},{13,124},{13,125},{13,125},{13,126},{13,127},{13,127},{13,127},{13,128},{14,129},{14,129},{14,130},{14,131},{14,131},{14,132},{14,133},{14,134},{14,134},{14,134},{14,135},{14,135},{14,136},{14,137},{14,138},{14,138},{14,139},{14,139},{14,139},{14,140},{15,141},{15,142},{15,142},{15,143},{15,144},{15,144},{15,144},{15,145},{15,146},{15,146},{15,147},{15,147},{15,147},{15,148},{15,149},{16,150},{16,150},{16,150},{16,151},{16,151},{16,152},{16,153}},
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{{0,0},{0,0},{0,0},{0,0},{0,0},{0,0},{0,0},{0,0},{0,0},{0,0},{0,0},{0,0},{0,0},{0,0},{0,0},{0,0},{0,0},{0,0},{0,0},{0,0},{0,0},{0,0},{0,0},{0,0},{0,0},{0,0},{0,0},{0,0},{0,0},{0,0},{0,0},{0,0},{0,0},{0,0},{0,0},{0,0},{0,0},{0,0},{0,0},{0,0},{0,0},{0,0},{0,0},{0,0},{0,0},{0,0},{0,0},{0,0},{0,0},{0,0},{0,0},{0,0},{0,0},{0,0},{0,0},{0,0},{0,0},{0,0},{0,0},{0,0},{0,0},{0,0},{0,0},{0,0},{0,0},{0,0},{0,0},{0,0},{0,0},{0,0},{0,0},{105,19},{106,21},{106,24},{107,26},{107,29},{108,32},{108,35},{110,38},{110,41},{110,44},{111,48},{111,51},{111,54},{112,58},{112,61},{113,65},{113,69},{113,72},{113,76},{114,80},{114,84},{114,87},{114,91},{114,95},{114,99},{114,103},{114,107},{114,111},{114,114},{114,118},{114,121},{114,126},{114,129},{113,133},{113,136},{113,139},{112,143},{112,146},{112,149},{111,152},{111,155},{110,158},{110,161},{109,164},{108,166},{0,0},{0,0},{0,0},{0,0},{0,0},{0,0},{0,0},{0,0},{0,0},{0,0},{0,0},{0,0},{0,0},{0,0},{0,0},{0,0},{0,0},{0,0},{0,0},{0,0},{0,0},{0,0},{0,0},{0,0},{0,0},{0,0},{0,0},{0,0},{0,0},{0,0},{0,0},{0,0},{0,0},{0,0},{0,0},{0,0},{0,0},{0,0},{0,0},{0,0},{0,0},{0,0},{0,0},{0,0},{0,0},{0,0},{0,0},{0,0},{0,0},{0,0},{0,0},{0,0},{0,0},{0,0},{0,0},{0,0},{0,0},{0,0},{0,0},{0,0},{0,0},{0,0},{0,0},{0,0},{0,0},{0,0},{0,0},{0,0}}
};

 


int frame=0;        //测帧数用
int fr=0;           //测场中断用


/*
//摄像头图像采集中断处理函数
void PORTD_Interrupt(void)
{     
  //行中断PTD14
  if((PORTD_ISFR & 0x4000))//行中断 (1<<14)
  {    
      PORTD_ISFR |= 0x4000;  //清除中断标识
      DMATransDataStart(DMA_CH4,(uint32_t)(&Image_Data1[Line_Cont][0]));     
      if(Line_Cont > IMAGEH)  //采集结束
      { 
        Line_Cont=0; 
        return ;
      } 
      Line_Cont++;            //行计数
      return ;
   
  }
  //场中断PTD15
  if((PORTD_ISFR & 0x8000))//(1<<15)
  {
    PORTD_ISFR |= 0x8000; //清除中断标识
    // 用户程序 
    Line_Cont = 0; //行计数清零
   //   Field_Over_Flag=1;     //场结束标识
    
  } 
}
*/



//测试主函数
void Test_LQV034(void)
{  
  LQMT9V034_Init();        //摄像头初始化

  while(1)
  { 
    LED_Ctrl(LED1, RVS);   //LED指示程序运行状态
    if(Field_Over_Flag)    //完成一场图像采集后显示并发送数据到上位机
    {

        No=!No;

     Get_Use_Image();     //采集图像数据存放数组
     Get_01_Value();      //二值化图像数据
     Pixle_Filter();                      //滤波，降低噪点
    if(GPIO_Get(PTE0))
      {
        //TFTSPI_Show_Pic3(18, 8, 94, 60, Pixle);    
      }

      Field_Over_Flag= 0;  
      
    }    
  }
}


void LQMT9V034_Init(void)
{     
  uint16_t data = 0;  
  TFTSPI_CLS(u16BLUE);
 //摄像头寄存器设置
  SCCB_Init();                     //两个地址口都拉高，为MT9V034_I2C_ADDR  
  if(SCCB_RegRead(MT9V034_I2C_ADDR>>1,MT9V034_CHIP_VERSION,&data) == 0)//读取摄像头版本寄存器 
  {     
    if(data != MT9V034_CHIP_ID)                                  //芯片ID不正确，说明没有正确读取导数据，等待      
    { 
      TFTSPI_P8X8Str(0,0,(u8*)"034 dpi!!", u16RED, u16BLUE);                       //摄像头识别失败，停止运行
      while(1); 
    } 
    else                                                   //芯片ID正确
    { 
      TFTSPI_P8X8Str(0,0,(u8*)"V034 OK", u16RED, u16BLUE);
    }
  } 
  else 
  { 
    while(1); //摄像头识别失败，停止运行
  }  

  MT9V034_SetFrameResolution(IMAGEH, IMAGEW);//设置摄像头图像4*4分频输出PCLK, 27/4 = 6.75M ,BIT4,5镜像设置:上下左右均镜像   
  MT9V034_SetAutoExposure(0);  
  SCCB_RegWrite(MT9V034_I2C_ADDR, 0xAC, 0x0001);
  SCCB_RegWrite(MT9V034_I2C_ADDR, 0xAD, 0x01E0);  
  SCCB_RegWrite(MT9V034_I2C_ADDR, 0x2C, 0x0004);
  
  //SCCB_RegWrite(MT9V034_I2C_ADDR, 0x7F, 0x3000);           // test pattern

  SCCB_RegWrite(MT9V034_I2C_ADDR, MT9V034_ANALOG_CTRL, MT9V034_ANTI_ECLIPSE_ENABLE);
  SCCB_RegWrite(MT9V034_I2C_ADDR, 0x0F, 0x0000);  
  SCCB_RegWrite(MT9V034_I2C_ADDR, MT9V034_HDR_ENABLE_REG, 0x0101); // 0x0F bit8:1HDR,0linear; bit1:1彩色,0灰度;bit0:1HDR,0linear
  //MT9V034_WriteReg16(MT9V034_HDR_ENABLE_REG, 0x0103);     // 0x0F bit8:1HDR,0linear; bit1:1彩色,0灰度;bit0:1HDR,0linear
  //0x07 Chip Control bit2-0:0逐行扫描,1无效，2场，3单场；bit5:1立体视觉使能,bit7:1并口使能；bit8:1同步模式;bit9:1正常操作；bit15:0A/1B
  SCCB_RegWrite(MT9V034_I2C_ADDR,MT9V034_CHIP_CONTROL, 0x0188);          //Context A  
  SCCB_RegWrite(MT9V034_I2C_ADDR, MT9V034_ROW_NOISE_CORR_CTRL_REG, 0);   //0x70  0x0000 
  SCCB_RegWrite(MT9V034_I2C_ADDR, MT9V034_AEC_AGC_ENABLE_REG,0x0303);   //0xAF  AEC/AGC A~bit0:1AE;bit1:1AG/B~bit2:1AE;bit3:1AG     0x0303
  
  SCCB_RegWrite(MT9V034_I2C_ADDR, MT9V034_MIN_EXPOSURE_REG, 0x0001);     //0xAC  最小粗快门宽度   0x0001
  SCCB_RegWrite(MT9V034_I2C_ADDR, MT9V034_MAX_EXPOSURE_REG, 0x01E0);     //0xAD  最大醋快门宽度   0x01E0-480
  SCCB_RegWrite(MT9V034_I2C_ADDR, MT9V034_MAX_GAIN_REG, 50);             //0xAB  最大模拟增益     64
  
  SCCB_RegWrite(MT9V034_I2C_ADDR, MT9V034_AGC_AEC_PIXEL_COUNT_REG, 188*120);//0xB0  用于AEC/AGC直方图像素数目,最大44000   4096=320*240  
  SCCB_RegWrite(MT9V034_I2C_ADDR, MT9V034_ADC_RES_CTRL_REG, 0x0303);     //0x1C  here is the way to regulate darkness :)    
  
  SCCB_RegWrite(MT9V034_I2C_ADDR,0x13,0x2D2E);//We also recommended using R0x13 = 0x2D2E with this setting for better column FPN.  
  SCCB_RegWrite(MT9V034_I2C_ADDR,0x20,0x0117);//0x01C7对比度差，发白；0x03C7对比度提高 Recommended by design to improve performance in HDR mode and when frame rate is low.
  SCCB_RegWrite(MT9V034_I2C_ADDR,0x24,0x0010);//Corrects pixel negative dark offset when global reset in R0x20[9] is enabled.
  SCCB_RegWrite(MT9V034_I2C_ADDR,0x2B,0x0003);//Improves column FPN.
  SCCB_RegWrite(MT9V034_I2C_ADDR,0x2F,0x0003);//Improves FPN at near-saturation.  
  
  //SCCB_RegWrite(MT9V034_I2C_ADDR, 0x08, 0x03D4);
  //SCCB_RegWrite(MT9V034_I2C_ADDR, 0x09, 0x03E7);
  //100DB //设置曝光时间
  SCCB_RegWrite(MT9V034_I2C_ADDR,MT9V034_SHUTTER_WIDTH1,0x01BB);        //0x08 Coarse Shutter IMAGEW 1
  SCCB_RegWrite(MT9V034_I2C_ADDR,MT9V034_SHUTTER_WIDTH2,0x01D9);        //0x09 Coarse Shutter IMAGEW 2
  SCCB_RegWrite(MT9V034_I2C_ADDR,MT9V034_SHUTTER_WIDTH_CONTROL,0x0064); //0x0A Coarse Shutter IMAGEW Control 
  SCCB_RegWrite(MT9V034_I2C_ADDR,MT9V034_V2_CTRL_REG_A, 0x001A);        //0x32   0x001A  
  SCCB_RegWrite(MT9V034_I2C_ADDR,MT9V034_TOTAL_SHUTTER_WIDTH,0x0078);   //0x0B Coarse Shutter IMAGEW Total
  SCCB_RegWrite(MT9V034_I2C_ADDR,MT9V034_HDR_ENABLE_REG,0x0103);        //0x0F High Dynamic Range enable,bit is set (R0x0F[1]=1), the sensor uses black level correction values from one green plane, which are applied to all colors.
  SCCB_RegWrite(MT9V034_I2C_ADDR, MT9V034_AGC_AEC_DESIRED_BIN_REG, 60); //0xA5  图像亮度  50  1-64
  SCCB_RegWrite(MT9V034_I2C_ADDR,MT9V034_ANALOG_GAIN,0x8010);           //0x35
  
  //80dB HDR
  //SCCB_RegWrite(MT9V034_I2C_ADDR, 0x08, 0x03CA);
  //SCCB_RegWrite(MT9V034_I2C_ADDR, 0x09, 0x03DE);
  //SCCB_RegWrite(MT9V034_I2C_ADDR, 0x0A, 0x0064);
  //SCCB_RegWrite(MT9V034_I2C_ADDR, 0x0B, 0x03E8);
  //SCCB_RegWrite(MT9V034_I2C_ADDR, 0x0F, 0x0103);
  //SCCB_RegWrite(MT9V034_I2C_ADDR, 0x35, 0x8010);   

  SCCB_RegWrite(MT9V034_I2C_ADDR, MT9V034_RESET, 0x03);          //0x0c  复位 
  
  //GPIO口初始化
  EXTI_Init(PTD,14,rising_down);   //行中断
  EXTI_Init(PTD,15,falling_up);    //场中断  
  GPIO_Init(PTD,0,GPI,0);          //八位数据输入口      
  GPIO_Init(PTD,1,GPI,0);
  GPIO_Init(PTD,2,GPI,0);
  GPIO_Init(PTD,3,GPI,0);
  GPIO_Init(PTD,4,GPI,0);
  GPIO_Init(PTD,5,GPI,0);
  GPIO_Init(PTD,6,GPI,0);
  GPIO_Init(PTD,7,GPI,0);
  //初始化DMA采集 ，在这里修改采集接口PTD_BYTE0_IN是D0--D7。   PLCK接的是PTD13。  
  DMA_PORTx2BUFF_Init (DMA_CH4, (void *)&PTD_BYTE0_IN,(void*)Image_Data1, PTD13, DMA_BYTE1, IMAGEW, DMA_rising);  
}

 
void MT9V034_SetFrameResolution(uint16_t height,uint16_t width)
{
  uint16_t data = 0;
  
  if((width*4)<=MAX_IMAGE_WIDTH && (height*4)<=MAX_IMAGE_HEIGHT)
  {
    width *= 4;
    height *= 4;
    data |= MT9V034_READ_MODE_ROW_BIN_4;
    data |= MT9V034_READ_MODE_COL_BIN_4;
  }
  else if((width*2)<=MAX_IMAGE_WIDTH && (height*2)<=MAX_IMAGE_HEIGHT)
  {
    width *= 2;
    height *= 2;
    data |= MT9V034_READ_MODE_ROW_BIN_2;
    data |= MT9V034_READ_MODE_COL_BIN_2;
  }
  
  //SCCB_RegWrite(MT9V034_I2C_ADDR,0x01,MT9V034_COLUMN_START_DEF);     // Column Start
  //SCCB_RegWrite(MT9V034_I2C_ADDR,0x02,MT9V034_ROW_START_DEF);        // Row Start  
  //SCCB_RegWrite(MT9V034_I2C_ADDR,0x03,MT9V034_WINDOW_HEIGHT_DEF);    // height 
  //SCCB_RegWrite(MT9V034_I2C_ADDR,0x04,MT9V034_WINDOW_WIDTH_DEF);     // width  
  //SCCB_RegWrite(MT9V034_I2C_ADDR,0x05,MT9V034_HORIZONTAL_BLANKING_MIN);   // Horizontal Blanking  809-640
  //SCCB_RegWrite(MT9V034_I2C_ADDR,0x06,MT9V034_VERTICAL_BLANKING_MIN);     // Vertical Blanking    499-480 
  
  //设置图像输出大小为120*188，不损失视野，同时满足智能车需要
  //SCCB_RegWrite(MT9V034_I2C_ADDR,0x0D,0x030A);   //设置摄像头图像4*4分频输出PCLK, 27/4 = 6.75M ,BIT4,5镜像设置 
  //SCCB_RegWrite(MT9V034_I2C_ADDR,0x0D,0x033A);   //设置摄像头图像4*4分频输出PCLK, 27/4 = 6.75M ,BIT4,5镜像设置:上下左右均镜像 
  
  data |= (MT9V034_READ_MODE_ROW_FLIP|MT9V034_READ_MODE_COLUMN_FLIP);       //LQ-MT9V034 needs vertical mirror to capture correct image
  
  SCCB_RegWrite(MT9V034_I2C_ADDR, MT9V034_READ_MODE, data);
  
  SCCB_RegWrite(MT9V034_I2C_ADDR, MT9V034_WINDOW_WIDTH,  width);
  SCCB_RegWrite(MT9V034_I2C_ADDR, MT9V034_WINDOW_HEIGHT, height);
  
  SCCB_RegWrite(MT9V034_I2C_ADDR, MT9V034_COLUMN_START, (MAX_IMAGE_WIDTH-width)/2+MT9V034_COLUMN_START_MIN);
  SCCB_RegWrite(MT9V034_I2C_ADDR, MT9V034_ROW_START, (MAX_IMAGE_HEIGHT-height)/2+MT9V034_ROW_START_MIN);
}

void MT9V034_SetAutoExposure(char enable)
{
  uint16_t reg =0;
  SCCB_RegRead(MT9V034_I2C_ADDR, MT9V034_AEC_AGC_ENABLE,&reg);
  if(1 == enable)
  {
    SCCB_RegWrite(MT9V034_I2C_ADDR, MT9V034_AEC_AGC_ENABLE, reg|MT9V034_AEC_ENABLE|MT9V034_AGC_ENABLE);
  }
  else
  {
    SCCB_RegWrite(MT9V034_I2C_ADDR, MT9V034_AEC_AGC_ENABLE, reg&~(MT9V034_AEC_ENABLE|MT9V034_AGC_ENABLE));
  }
}


void MT9V034_Reset(void)
{
  //Reset MT9V034, but register config will not change.
  SCCB_RegWrite(MT9V034_I2C_ADDR, MT9V034_RESET, 0x0001);
  time_delay_ms(10);
  
  //Unlock MT9V034, allowing user to initiate register settings and readout
  SCCB_RegWrite(MT9V034_I2C_ADDR, MT9V034_CHIP_CONTROL, 0x0188);
  
  //Reset Again.
  SCCB_RegWrite(MT9V034_I2C_ADDR, MT9V034_RESET, 0x0001);
  time_delay_ms(10);
}

void MT9V034_SetReservedReg(void)
{
  //Here we write some reserved registers as recommendations from Rev.G datasheet, Table.8
  SCCB_RegWrite(MT9V034_I2C_ADDR, 0x13, 0x2D2E);
  SCCB_RegWrite(MT9V034_I2C_ADDR, 0x20, 0x03C7);
  SCCB_RegWrite(MT9V034_I2C_ADDR, 0x24, 0x001B);
  SCCB_RegWrite(MT9V034_I2C_ADDR, 0x2B, 0x0003);
  SCCB_RegWrite(MT9V034_I2C_ADDR, 0x2F, 0x0003);
}


// 获取需要的图像数据
__ramfunc void Get_Use_Image(void)
{
  int i = 0,j = 0,row = 0,line = 0;
  
  
    for(i = 0; i  < 120; i+=2)  //120行，每2行采集一行，
    {
      for(j = 0;j < 188; j+=2)  //188，
      {        
        Image_Use[row][line] = Image_Data1[i][j];         
        line++;        
      }      
      line = 0;
      row++;      
    }  
  
  
}




//二值化
void Get_01_Value(void)
{
  int i = 0,j = 0;
  u8 GaveValue;
  u32 tv=0;
 // char txt[16];
  
  //累加
  for(i = 0; i <60; i++)
  {    
    for(j = 0; j <91; j++)
    {                            
      tv+=Image_Use[i][j];   //累加  
    } 
  }
  GaveValue=tv/60/91;     //求平均值,光线越暗越小，全黑约35，对着屏幕约160，一般情况下大约100 
  //按照均值的比例进行二值化
  GaveValue=(int)(0.99*GaveValue);//*7/10+10;        //此处阈值设置，根据环境的光线来设定 值越大黑点越多
  for(i = 0; i < LCDH; i++)
  {
    for(j = 0; j < LCDW; j++)
    {                                
      if(Image_Use[i][j] >GaveValue)//平均值阈值 
        Pixle[i][j] =1;        
      else                                        
        Pixle[i][j] =0;
    }    
  }
}



//三面以上反数围绕清除噪点
void Pixle_Filter(void)
{  
  int nr; //行
  int nc; //列
  
  for(nr=1; nr<LCDH-1; nr++)
  {  	    
    for(nc=1; nc<LCDW-1; nc=nc+1)
    {
      if((Pixle[nr][nc]==0)&&(Pixle[nr-1][nc]+Pixle[nr+1][nc]+Pixle[nr][nc+1]+Pixle[nr][nc-1]>2))         
      {
        Pixle[nr][nc]=1;
      }	
      else if((Pixle[nr][nc]==1)&&(Pixle[nr-1][nc]+Pixle[nr+1][nc]+Pixle[nr][nc+1]+Pixle[nr][nc-1]<2))         
      {
        Pixle[nr][nc]=0;
      }	
    }	  
  }  
}

//图像矫正变换(注意调用的方法
void biaoding(void)
{ 
    int i,j;//t=0,l=0;
   // int line=0,row=0;
    if(No)
    {
      for(i=0;i<120;i++)
      {
        for(j=0;j<184;j++)
        {
          if((ans[i][j][0]==0)&&(ans[i][j][1]==0))
            Pic2[i][j]=0x00;
          else
          Pic2[i][j]=Image_Data2[ans[i][j][0]][ans[i][j][1]];
        }
      }
    }
    else
    {
      for(i=0;i<120;i++)
      {
        for(j=0;j<184;j++)
        {
           if((ans[i][j][0]==0)&&(ans[i][j][1]==0))
              Pic2[i][j]=0x00;
          else
              Pic2[i][j]=Image_Data1[ans[i][j][0]][ans[i][j][1]];
        }
      }    
    }
}



/******************************下面是sccb驱动*****************************/




/*************************************************************************
* 北京龙邱智能科技 KV58智能车母板           
*
*  函数名称：void SCCB_Init(void)
*  功能说明：配置SCCB所用引脚为GPIO功能，暂时不配置数据方向
*  参数说明：无
*  函数返回：无
*  修改时间：2017年12月5日
*  备    注：
*************************************************************************/
void SCCB_Init(void)
{
  GPIO_Init(PTD, 10,GPO,0);//配置为GPIO功能
  GPIO_Init(PTD, 11,GPO,0);//配置为GPIO功能  
}

/*************************************************************************
* 北京龙邱智能科技 KV58智能车母板           
*
*  函数名称：void SCCB_Wait(void)
*  功能说明：SCCB等待演示
*  参数说明：无
*  函数返回：无
*  修改时间：2017年12月5日
*  备    注：
*************************************************************************/
void SCCB_Wait(void)
{
  uint8 i=0;
  for(i=0;i<100;i++)
  { 
    asm ("nop");
  }  
}

/*************************************************************************
* 北京龙邱智能科技 KV58智能车母板           
*
*  函数名称：void SCCB_Star(void)
*  功能说明：启动函数
*  参数说明：无
*  函数返回：无
*  修改时间：2017年12月5日
*  备    注：
*************************************************************************/
void SCCB_Star(void)
{
  SCL_Out;
  SDA_Out;
  SCCB_Wait();
  SDA_High;
  SCL_High; 
  SCCB_Wait();
  SDA_Low;
  SCCB_Wait();
  SCL_Low; 
  SCCB_Wait();
}
/*************************************************************************
* 北京龙邱智能科技 KV58智能车母板           
*
*  函数名称：void SCCB_Stop(void)
*  功能说明：停止函数
*  参数说明：无
*  函数返回：无
*  修改时间：2017年12月5日
*  备    注：
*************************************************************************/
void SCCB_Stop(void)
{
  SCL_Out;
  SDA_Out;
  SCCB_Wait();
  SDA_Low;
  SCCB_Wait();
  SCL_High; 
  SCCB_Wait();
  SDA_High;
  SCCB_Wait();  
}
/*************************************************************************
* 北京龙邱智能科技 KV58智能车母板           
*
*  函数名称：uint8 SCCB_SendByte(uint8 Data)
*  功能说明：SCCB发送字节函数
*  参数说明：要发送的字节
*  函数返回：应答信号
*  修改时间：2017年12月5日
*  备    注：
*************************************************************************/
uint8 SCCB_SendByte(uint8 Data)
{
  uint8 i;
  uint8 Ack;
  SDA_Out;
  for( i=0; i<8; i++)
  {
    if(Data & 0x80) SDA_High;
    else            SDA_Low;    
    Data <<= 1;
    SCCB_Wait();
    SCL_High;      
    SCCB_Wait();
    SCL_Low;
    SCCB_Wait();
  }
  SDA_High;
  SDA_In;
  SCCB_Wait();
  
  SCL_High;
  SCCB_Wait();
  Ack = SDA_Data;
  SCL_Low;
  SCCB_Wait();
  return Ack;
}
/*************************************************************** 

* 
* 函数名称：uint8 SCCB_ReadByte(void) 
* 功能说明：SCCB读取字节函数 
* 参数说明： 
* 函数返回：读取字节 
* 修改时间：2017年12月5日 
* 备 注： 
***************************************************************/ 
uint8 SCCB_ReadByte(void) 
{ 
  uint8 i; 
  uint8_t byte; 
  SCL_Out; 
  SDA_In; //使能输入
  for( i=0; i<8; i++) 
  { 
    SCL_Low;
    SCCB_Wait(); 
    SCL_High;
    SCCB_Wait();
    byte = (byte<<1)|(SDA_Data & 1);
  }
  SCL_Low; 
  SDA_Out;
  SCCB_Wait(); 
  return byte; 
} 
/*************************************************************** 

* 
* 函数名称：static void SCCB_Ack(void) 
* 功能说明：IIC有回复信号 
* 参数说明： 
* 函数返回：void 
* 修改时间：2017年12月5日 
* 备 注： 
***************************************************************/ 
static void SCCB_Ack(void) 
{ 
  SCL_Out; 
  SDA_Out;
  SCL_Low;
  SDA_Low;
  SCCB_Wait();
  SCL_High;
  SCCB_Wait();
  SCL_Low;
  SCCB_Wait();
} 
/*************************************************************** 

* 
* 函数名称：static void SCCB_NAck(void) 
* 功能说明：IIC无回复信号 
* 参数说明： 
* 函数返回：void 
* 修改时间：2017年12月5日 
* 备 注： 
***************************************************************/ 
static void SCCB_NAck(void) 
{ 
  SCL_Out; 
  SDA_Out;
  SCL_Low;
  SCCB_Wait();
  SDA_High;
  SCCB_Wait();
  SCL_High;
  SCCB_Wait();
  SCL_Low;
  SCCB_Wait();
} 

/*************************************************************************
* 北京龙邱智能科技 KV58智能车母板           
*
*  函数名称：void SCCB_RegWrite(uint8 Device,uint8 Address,uint16 Data)
*  功能说明：向设备写数据
*  参数说明：要发送的字节
*  函数返回：应答信号
*  修改时间：2017年12月5日
*  备    注：
*************************************************************************/
void SCCB_RegWrite(uint8 Device,uint8 Address,uint16 Data)
{
  uint8 i;
  uint8 Ack;
  
  for( i=0; i<3; i++)
  {
    SCCB_Star();
    Ack = SCCB_SendByte(Device);
    if( Ack == 1 )
    {
      continue;
    }
    
    Ack = SCCB_SendByte(Address);
    if( Ack == 1 )
    {
      continue;
    }
    
    Ack = SCCB_SendByte((uint8)(Data>>8));
    Ack = SCCB_SendByte((uint8)Data);
    if( Ack == 1 )
    {
      continue;
    }
    
    SCCB_Stop();
    if( Ack == 0 ) break;
  }
}
/*************************************************************** 

* 
* 函数名称：uint8_t SCB_RegRead(uint8_t Device,uint8_t Address,uint16_t *Data) 
* 功能说明：读取数据 
* 参数说明： 
* 函数返回：void 
* 修改时间：2017年12月5日 
* 备 注： 
***************************************************************/ 
uint8_t SCCB_RegRead(uint8_t Device,uint8_t Address,uint16_t *Data) 
{   
  uint8 Ack = 0;
  Device = Device<<1;
  SCCB_Star();
  Ack += SCCB_SendByte(Device);
  
  Ack += SCCB_SendByte(Address);
  
  SCCB_Star();
  Ack += SCCB_SendByte(Device + 1);
  
  *Data = SCCB_ReadByte();
  SCCB_Ack();
  *Data = *Data<<8;
  
  *Data += SCCB_ReadByte();
  SCCB_NAck();
  
  SCCB_Stop();
  
  return  Ack;
} 
/***************************************************************  
* 
* 函数名称：int SCCB_Probe(uint8_t chipAddr) 
* 功能说明：查询该地址的设备是否存在 
* 参数说明： 
* 函数返回：void 
* 修改时间：2017年12月5日 
* 备 注： 
***************************************************************/ 
int SCCB_Probe(uint8_t chipAddr) 
{ 
  uint8_t err;
  err = 0;
  chipAddr <<= 1;
  
  SCCB_Star();
  err = SCCB_SendByte(chipAddr);
  SCCB_Stop();
  
  return err;
}



